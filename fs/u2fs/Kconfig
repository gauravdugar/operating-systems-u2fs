## fs/u2fs/Kconfig
```kconfig
config U2_FS
	tristate "U2fs stackable file system (EXPERIMENTAL)"
	depends on EXPERIMENTAL
	help
	  U2fs is a stackable file system which simply passes its
	  operations to the lower layer.  It is designed as a useful
	  template for developing or debugging other stackable file systems,
	  and more (see Documentation/filesystems/u2fs.txt).  See
	  <http://u2fs.filesystems.org/> for details.
config EXTRA_CREDIT
	 bool "Unionfs extended attributes"
	 depends on U2_FS
	 help
	   Eliminates duplicates entries. Extra Xredit implementation.
```
